## firmware/can_logger/sdkconfig.defaults
```kconfig
# コンソール(printf)出力先をネイティブUSB(USB Serial/JTAG)にする。
# XIAO ESP32C3のUSB-Cポート1本で書き込みもログ受信も行う。
# これによりUART0(GPIO20/21)が解放され、GPIO20をTWAI RXに使える。
CONFIG_ESP_CONSOLE_USB_SERIAL_JTAG=y
CONFIG_ESP_CONSOLE_SECONDARY_NONE=y

# esptoolのチップ検出で手持ちXIAO ESP32C3の実フラッシュは4MBと判明しているため
# 実容量に合わせる(can_selftest等の旧「2MB」表記は実態と不一致)。
CONFIG_ESPTOOLPY_FLASHSIZE_4MB=y
CONFIG_ESPTOOLPY_FLASHSIZE="4MB"

# ブート直後のブートローダーログがネイティブUSBに漏れて記録先ファイルに
# 混入しないよう抑制する。
CONFIG_BOOTLOADER_LOG_LEVEL_NONE=y
```

## firmware/can_obd_logger/sdkconfig.defaults
```kconfig
# can_logger/sdkconfig.defaults と同一内容。理由も同じ。

# コンソール(printf)出力先をネイティブUSB(USB Serial/JTAG)にする。
# XIAO ESP32C3のUSB-Cポート1本で書き込みもログ受信も行う。
# これによりUART0(GPIO20/21)が解放され、GPIO20をTWAI RX・GPIO21をTWAI TXに使える。
CONFIG_ESP_CONSOLE_USB_SERIAL_JTAG=y
CONFIG_ESP_CONSOLE_SECONDARY_NONE=y

# esptoolのチップ検出で手持ちXIAO ESP32C3の実フラッシュは4MBと判明しているため
# 実容量に合わせる(can_selftest等の旧「2MB」表記は実態と不一致)。
CONFIG_ESPTOOLPY_FLASHSIZE_4MB=y
CONFIG_ESPTOOLPY_FLASHSIZE="4MB"

# ブート直後のブートローダーログがネイティブUSBに漏れて記録先ファイルに
# 混入しないよう抑制する。('#'始まりでもフレーム行でもないためパースエラーになる)
CONFIG_BOOTLOADER_LOG_LEVEL_NONE=y
```

## firmware/can_selftest/sdkconfig.defaults
```kconfig
# コンソール(printf/ESP_LOG)の出力先をネイティブUSB(USB Serial/JTAG)にする。
# XIAO ESP32C3 の USB-C ポート1本で書き込みもログ確認も行うため。
# これによりUART0(GPIO20/21)が解放され、そのままTWAIのTX/RXに使える。
CONFIG_ESP_CONSOLE_USB_SERIAL_JTAG=y
CONFIG_ESP_CONSOLE_SECONDARY_NONE=y

# 手持ちの実機(Seeed Studio XIAO ESP32C3)のフラッシュ設定。
# 既存の検証プロジェクト(usb_otg_test / ../ 直下firmware)と同じ2MB指定に合わせる。
CONFIG_ESPTOOLPY_FLASHSIZE_2MB=y
CONFIG_ESPTOOLPY_FLASHSIZE="2MB"
```

## firmware/logger_v1/sdkconfig.defaults
```kconfig
CONFIG_ESP_DEFAULT_CPU_FREQ_MHZ_240=y
CONFIG_ESP_DEFAULT_CPU_FREQ_MHZ=240
CONFIG_ESPTOOLPY_FLASHSIZE_16MB=y
CONFIG_ESPTOOLPY_FLASHSIZE="16MB"
CONFIG_ESPTOOLPY_FLASHFREQ_80M=y
CONFIG_SPIRAM=y
CONFIG_SPIRAM_MODE_OCT=y
CONFIG_SPIRAM_TYPE_AUTO=y
CONFIG_SPIRAM_SPEED_80M=y
CONFIG_SPIRAM_BOOT_INIT=y
CONFIG_SPIRAM_MEMTEST=y
CONFIG_SPIRAM_USE_MALLOC=y
CONFIG_SPIRAM_MALLOC_ALWAYSINTERNAL=16384
CONFIG_SPIRAM_MALLOC_RESERVE_INTERNAL=65536
CONFIG_ESP_CONSOLE_UART_DEFAULT=y
CONFIG_ESP_CONSOLE_UART_NUM=0
CONFIG_ESP_CONSOLE_UART_BAUDRATE=115200
CONFIG_ESP_CONSOLE_SECONDARY_NONE=y
CONFIG_TINYUSB_CDC_ENABLED=y
CONFIG_TINYUSB_CDC_COUNT=1
CONFIG_TINYUSB_CDC_RX_BUFSIZE=2048
CONFIG_TINYUSB_CDC_TX_BUFSIZE=4096
CONFIG_TINYUSB_DESC_USE_ESPRESSIF_VID=y
CONFIG_TINYUSB_DESC_USE_DEFAULT_PID=y
CONFIG_TINYUSB_DESC_MANUFACTURER_STRING="RaceCapture DIY"
CONFIG_TINYUSB_DESC_PRODUCT_STRING="logger_v1"
# Retain the diagnostic device serial so Windows retains the known COM port.
CONFIG_TINYUSB_DESC_SERIAL_STRING="LOGGER-V1-TEST"
CONFIG_TINYUSB_DESC_CDC_STRING="RaceCapture logger_v1"
CONFIG_FREERTOS_HZ=1000
CONFIG_TWAI_SUPPRESS_DEPRECATE_WARN=y
CONFIG_TWAI_ISR_IN_IRAM_LEGACY=y
CONFIG_FATFS_LFN_HEAP=y
CONFIG_FATFS_MAX_LFN=128
```

## firmware/sd_card_test/sdkconfig.defaults
```kconfig
# 手持ちの実機(ESP32-S3-DevKitC-1 N16R8)はフラッシュ16MB。
# 未設定だとPlatformIO既定のボード定義(N8/8MB)のオフセットで書き込まれ、
# 実機と食い違って書き込み・起動に失敗する(1-4-2で判明した教訓、
# ../platformio.iniのboard_build.esp-idf.custom_sdkconfigは無視されるため
# sdkconfig.defaultsへ直接書く方式にしている)。
CONFIG_ESPTOOLPY_FLASHSIZE_16MB=y
CONFIG_ESPTOOLPY_FLASHSIZE="16MB"
```

## firmware/usb_otg_test/sdkconfig.defaults
```kconfig
# printf/ESP_LOGの出力先をUART0のみに限定する。
# ネイティブUSB(USB Serial/JTAG)はRaceCaptureアプリとのJSON会話専用の
# クリーンなチャンネルとして使うため、デバッグログを混ぜない
# (混ざるとアプリ側のJSON行パーサがデバッグ文字列を解釈できずに壊れる)。
CONFIG_ESP_CONSOLE_UART_DEFAULT=y
CONFIG_ESP_CONSOLE_UART_NUM=0
CONFIG_ESP_CONSOLE_UART_BAUDRATE=115200
CONFIG_ESP_CONSOLE_SECONDARY_NONE=y

# 手持ちの実機(Seeed Studio XIAO ESP32C3)はフラッシュ2MB
# (../ 直下のfirmwareプロジェクトのsdkconfigと同じ設定に合わせる)
CONFIG_ESPTOOLPY_FLASHSIZE_2MB=y
CONFIG_ESPTOOLPY_FLASHSIZE="2MB"

# app起動前のブートローダー自体のログも、ネイティブUSB経由のリセット直後には
# ネイティブUSBポートに漏れて出てくる(app側のCONSOLE設定より前の段階のため)。
# RaceCaptureアプリとの初回応答にログ文字列が混入しないよう完全に無効化する。
CONFIG_BOOTLOADER_LOG_LEVEL_NONE=y
```

## v1_test/sdkconfig.defaults
```kconfig
# ESP32-S3-WROOM-1 N16R8: stay within the specified maximum CPU clock.
CONFIG_ESP_DEFAULT_CPU_FREQ_MHZ_240=y
CONFIG_ESP_DEFAULT_CPU_FREQ_MHZ=240
CONFIG_ESP32S3_DEFAULT_CPU_FREQ_240=y

# Board flash/PSRAM fitted population.
CONFIG_ESPTOOLPY_FLASHSIZE_16MB=y
CONFIG_ESPTOOLPY_FLASHSIZE="16MB"
CONFIG_ESPTOOLPY_FLASHFREQ_80M=y
CONFIG_ESPTOOLPY_FLASHFREQ="80m"
# ESP32-S3-WROOM-1-N16R8: 8 MiB octal PSRAM at its rated 80 MHz.
CONFIG_SPIRAM=y
# CONFIG_SPIRAM_MODE_QUAD is not set
CONFIG_SPIRAM_MODE_OCT=y
CONFIG_SPIRAM_TYPE_AUTO=y
CONFIG_SPIRAM_CLK_IO=30
CONFIG_SPIRAM_CS_IO=26
CONFIG_SPIRAM_SPEED_80M=y
CONFIG_SPIRAM_SPEED=80
CONFIG_SPIRAM_BOOT_HW_INIT=y
CONFIG_SPIRAM_BOOT_INIT=y
CONFIG_SPIRAM_PRE_CONFIGURE_MEMORY_PROTECTION=y
CONFIG_SPIRAM_USE_MALLOC=y
CONFIG_SPIRAM_MEMTEST=y
CONFIG_SPIRAM_MALLOC_ALWAYSINTERNAL=16384
CONFIG_SPIRAM_MALLOC_RESERVE_INTERNAL=32768
CONFIG_SPIRAM_ALLOW_STACK_EXTERNAL_MEMORY=y

# UART0 remains a clean diagnostic console through the A105.
CONFIG_ESP_CONSOLE_UART_DEFAULT=y
CONFIG_ESP_CONSOLE_UART_NUM=0
CONFIG_ESP_CONSOLE_UART_BAUDRATE=115200
CONFIG_ESP_CONSOLE_SECONDARY_NONE=y

# Native USB is a CDC-only RaceCapture protocol port.
CONFIG_TINYUSB_CDC_ENABLED=y
CONFIG_TINYUSB_CDC_COUNT=1
CONFIG_TINYUSB_CDC_RX_BUFSIZE=2048
CONFIG_TINYUSB_CDC_TX_BUFSIZE=2048
CONFIG_TINYUSB_DESC_USE_ESPRESSIF_VID=y
CONFIG_TINYUSB_DESC_USE_DEFAULT_PID=y
CONFIG_TINYUSB_DESC_MANUFACTURER_STRING="RaceCapture v1 test"
CONFIG_TINYUSB_DESC_PRODUCT_STRING="logger_v1 diagnostics"
CONFIG_TINYUSB_DESC_SERIAL_STRING="LOGGER-V1-TEST"
CONFIG_TINYUSB_DESC_CDC_STRING="RaceCapture logger_v1"

CONFIG_FREERTOS_HZ=1000
CONFIG_TWAI_SUPPRESS_DEPRECATE_WARN=y
```

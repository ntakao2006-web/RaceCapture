// Bounded interrupt UART bridge; no RF commands are generated by the MCU.
// Linux disappearance powers the modem off after 20 seconds. UART is independent
// of SD and sensor threads. GPIO RTS/CTS provide manual modem flow control.
#include <zephyr/drivers/uart.h>
K_MUTEX_DEFINE(lteLock);
static const device* lteDev=DEVICE_DT_GET(DT_PHANDLE_BY_IDX(DT_PATH(zephyr_user),serials,0));
static uint8_t lteTx[512],lteRx[4096];
static uint32_t txHead=0,txTail=0,rxHead=0,rxTail=0,ltePower=0;
static uint32_t lteSeen=0,lteStep=0,lteOver=0,lteReceived=0,lteSent=0;
static bool lteWant=false;
K_THREAD_STACK_DEFINE(lteStack,1024);
static struct k_thread lteThread;
static void lteIRQ(const device*d,void*){
 while(uart_irq_update(d)&&uart_irq_is_pending(d)){
  if(uart_irq_rx_ready(d)){uint8_t b[32];int n=uart_fifo_read(d,b,sizeof(b));if(n<=0)break;uint32_t h=rxHead,t=__atomic_load_n(&rxTail,__ATOMIC_ACQUIRE);for(int i=0;i<n;i++){lteReceived++;if(h-t<4096)lteRx[(h++)%4096]=b[i];else lteOver++;}__atomic_store_n(&rxHead,h,__ATOMIC_RELEASE);}
  if(uart_irq_tx_ready(d)){uint32_t t=txTail,h=__atomic_load_n(&txHead,__ATOMIC_ACQUIRE);if(t==h||digitalRead(D8)){uart_irq_tx_disable(d);continue;}int n=uart_fifo_fill(d,lteTx+t%512,min(h-t,512-t%512));__atomic_store_n(&txTail,t+n,__ATOMIC_RELEASE);lteSent+=n;}
 }
}
static int lteWrite(String c){
 k_mutex_lock(&lteLock,K_FOREVER);lteSeen=millis();int rc=0;
 if(c=="P1")lteWant=true;
 else if(c=="P0")lteWant=false;
 else {uint8_t b[18];int n=decode(c,b,18);uint32_t h=txHead,t=__atomic_load_n(&txTail,__ATOMIC_ACQUIRE);if(!lteWant||n<0)rc=-2;else if(h-t+(unsigned)n>512)rc=-1;else {for(int i=0;i<n;i++)lteTx[(h++)%512]=b[i];__atomic_store_n(&txHead,h,__ATOMIC_RELEASE);}}
 k_mutex_unlock(&lteLock);return rc;
}
static String lteRead(){
 k_mutex_lock(&lteLock,K_FOREVER);lteSeen=millis();char h[180];
 snprintf(h,sizeof(h),"{\"power\":%lu,\"overflows\":%lu,\"rx_bytes\":%lu,\"tx_bytes\":%lu,\"cts\":%d,\"rx\":\"",(unsigned long)ltePower,(unsigned long)lteOver,(unsigned long)lteReceived,(unsigned long)lteSent,digitalRead(D8));
 String s=h;uint32_t t=rxTail,n=min(__atomic_load_n(&rxHead,__ATOMIC_ACQUIRE)-t,512UL);for(unsigned i=0;i<n;i++)hexByte(s,lteRx[(t++)%4096]);__atomic_store_n(&rxTail,t,__ATOMIC_RELEASE);s+="\"}";k_mutex_unlock(&lteLock);return s;
}
static void lteWorker(void*,void*,void*){
 struct uart_config cfg={57600,UART_CFG_PARITY_NONE,UART_CFG_STOP_BITS_1,UART_CFG_DATA_BITS_8,UART_CFG_FLOW_CTRL_NONE};
 if(uart_configure(lteDev,&cfg)||uart_irq_callback_user_data_set(lteDev,lteIRQ,nullptr))return;
 uart_irq_tx_disable(lteDev);uart_irq_rx_enable(lteDev);
 for(;;){
  k_mutex_lock(&lteLock,K_FOREVER);uint32_t now=millis();
  if(lteWant&&now-lteSeen>20000)lteWant=false;
  if(!lteWant){if(ltePower){out(A2,LOW);out(A3,LOW);ltePower=0;uart_irq_tx_disable(lteDev);txTail=txHead;rxTail=rxHead;}}
  else if(!ltePower){out(A3,HIGH);lteStep=now;ltePower=1;}
  else if(ltePower==1&&now-lteStep>=200){out(A2,HIGH);lteStep=now;ltePower=2;}
  else if(ltePower==2&&now-lteStep>=1200){out(A2,LOW);ltePower=3;}
  out(D2,rxHead-rxTail>=3072?HIGH:LOW);
  if(ltePower==3&&!digitalRead(D8)&&txTail!=txHead)uart_irq_tx_enable(lteDev);
  k_mutex_unlock(&lteLock);k_sleep(K_MSEC(1));
 }
}
